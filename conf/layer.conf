## conf/layer.conf
```bitbake
# We have a conf and classes directory, add to BBPATH
BBPATH .= ":${LAYERDIR}"

# We have recipes-* directories, add to BBFILES
BBFILES += "${LAYERDIR}/recipes-*/*/*.bb \
            ${LAYERDIR}/recipes-*/*/*.bbappend"

BBFILE_COLLECTIONS += "meta-rfs-overlay"
BBFILE_PATTERN_meta-rfs-overlay = "^${LAYERDIR}/"
BBFILE_PRIORITY_meta-rfs-overlay = "6"

LAYERDEPENDS_meta-rfs-overlay = "core"
LAYERSERIES_COMPAT_meta-rfs-overlay = "dunfell"
```
